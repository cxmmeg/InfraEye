#include <stdint.h>
#include "module_IRsensor.h"

#include "config.h"
#include "MLX90640_API.h"
#include "MLX90640_I2C_Driver.h"

#include "driver/i2c.h"

float IRsensor_fEmissivity = 1.0;
float IRsensor_fReflectedTemp;
static uint16_t IRsensor_au16MLX_Frame[834];
uint8_t IRsensor_u8subPage = 0u;
uint16_t IRsensor_au16EEPROM_Data[832];
paramsMLX90640 IRsensor_sMLX_Parameters;

#ifndef LIVE_DATA
float mlx90640To[768] = {
26.828890, 26.369379, 24.731531, 22.822830, 21.742044, 22.154196, 21.248055, 18.652376, 21.279518, 21.589119, 21.223455, 19.639475, 21.423983, 22.051989, 25.295067, 25.472538, 30.299950, 31.372770, 32.081581, 29.557137, 25.280773, 24.964289, 22.820082, 19.773882, 21.649080, 22.629297, 23.314922, 21.471209, 22.833958, 23.748293, 23.172810, 21.104683, 
21.831778, 22.130459, 19.042555, 17.647865, 21.836405, 21.595093, 19.790569, 18.341248, 22.781235, 22.384573, 20.279596, 18.823023, 22.693974, 22.993046, 25.177101, 27.142065, 35.421604, 35.911507, 34.589447, 32.406796, 27.066525, 25.756014, 22.615564, 20.768702, 23.795815, 23.446800, 20.906960, 19.944033, 24.462500, 24.453224, 20.964813, 19.996763, 
27.617880, 27.547131, 25.577343, 23.458559, 23.608805, 23.738573, 22.861874, 20.991133, 21.590612, 22.319729, 21.519245, 20.288164, 21.938269, 22.815395, 25.927713, 26.551786, 33.361221, 33.240173, 32.115917, 29.616325, 25.323372, 25.363428, 23.786224, 21.434532, 22.344526, 22.720999, 23.137835, 20.769524, 23.419613, 23.431179, 23.695917, 21.461056, 
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32.088753, 30.563900, 28.151869, 27.495949, 31.573385, 30.869184, 26.378063, 22.739149, 25.992474, 25.923962, 25.064892, 25.197500, 29.335503, 29.400650, 27.571798, 26.694941, 30.337997, 29.997389, 28.669714, 27.251089, 31.289461, 32.086872, 30.189955, 28.874784, 28.749487, 28.855423, 25.507624, 24.638683, 28.104958, 28.932964, 24.717104, 23.813780};
#endif

uint8_t IRsensor_u8I2C_Scan();

uint8_t IRsensor_Init(void)
{
	int result = -55;
	uint8_t u8Address;
	int status;
	int error;
	uint16_t u16CtrlReg;

	MLX90640_I2CInit();
	// Scan I2C to make sure IR sensor is present
	//u8Address = IRsensor_u8I2C_Scan();

	// Initialize IR sensor
	/* Keed default resolution = 2*/
	//result = MLX90640_SetResolution(MLX90640_ADR, 0x02);
	ets_printf("Get current resolution\n");
	result = MLX90640_GetCurResolution(MLX90640_ADR);
	ets_printf("Result = %d\n",result);
	ets_printf("Set refresh rate\n");
	MLX90640_SetRefreshRate(MLX90640_ADR, RR16Hz);
	ets_printf("Set interleave mode\n");
	MLX90640_SetInterleavedMode(MLX90640_ADR);
	status = MLX90640_DumpEE (MLX90640_ADR, IRsensor_au16EEPROM_Data);
	status = MLX90640_ExtractParameters(IRsensor_au16EEPROM_Data, &IRsensor_sMLX_Parameters);

    error = MLX90640_I2CRead(MLX90640_ADR, 0x800D, 1, &u16CtrlReg);
    if(error == 0)
    {
    	MLX90640_vSwapBytes(&u16CtrlReg);
    	ets_printf("After init. 0x%x\n",u16CtrlReg);
    }


	return(result);
}

uint8_t IRsensor_u8I2C_Scan()
{
	uint8_t detectedAddress = 0xFF;
	uint8_t address;
	esp_err_t error;
	int nDevices;
	esp_err_t i2c_ret = ESP_OK;
	i2c_cmd_handle_t cmd;
	uint8_t data_h;
	uint8_t data_l;

	ets_printf("Scanning...\n");
 
  nDevices = 0;
  for(address = 1; address < 127; address++ )
  {
	  cmd = i2c_cmd_link_create();
	  i2c_master_start(cmd);
	  error = i2c_master_write_byte(cmd, (address << 1) | I2C_MASTER_READ, ACK_CHECK_EN);
	  i2c_master_read_byte(cmd, &data_h, 1);
	  i2c_master_read_byte(cmd, &data_l, 1);
	  i2c_master_stop(cmd);
	  i2c_ret = i2c_master_cmd_begin(I2C_MASTER_NUM, cmd, (1000 / portTICK_RATE_MS));	//"(# / portTICK_RATE_MS)"=maximum wait time. This task will be blocked until all the commands have been sent (not thread-safe - if you want to use one I2C port in different tasks you need to take care of multi-thread issues)
	  i2c_cmd_link_delete(cmd);
//	  ets_printf("0x%.2x|0x%x|%x\t", address, i2c_ret, (data_h<<8)+data_l);

    if (i2c_ret == ESP_OK)
    {
    	ets_printf("Found on address 0x%x...\n",address);
//      Serial.print("I2C device found at address 0x");
//      if (address<16)
//        Serial.print("0");
      detectedAddress = address;
//      Serial.print(address,HEX);
//      Serial.println("  !");
 
      nDevices++;
    }
    else if (error==4)
    {
//      Serial.print("Unknown error at address 0x");
//      if (address<16)
//        Serial.print("0");
//      Serial.println(address,HEX);
    }    
  }
//  if (nDevices == 0)
//    Serial.println("No I2C devices found\n");
//  else
//    Serial.println("done\n");
    return(detectedAddress);
}

uint8_t IRsensor_u8DataIsReady(void)
{
  uint8_t u8DataReady = 0;
  int32_t s32Error;
  uint16_t u16RegisterValue;

  /* Read status register */
  s32Error = MLX90640_I2CRead(MLX90640_ADR, MLX90640_STATUS_REG_ADDR, 1, &u16RegisterValue);
  if(s32Error == 0u)
  {
	  /* Set data ready flag */
	  u8DataReady = u16RegisterValue & 0x0008u;
	  /* Save subpage information */
	  IRsensor_u8subPage = u16RegisterValue & 0x0001u;
  }
  return(u8DataReady);
}

void IRsensor_LoadSubPage(float* mlx90640To)
{
	int status;

	status = MLX90640_GetFrameData_Custom(MLX90640_ADR, IRsensor_au16MLX_Frame, IRsensor_u8subPage);
   MLX90640_I2CWrite(MLX90640_ADR, 0x8000, 0x0010);
  #ifdef LIVE_DATA
  // -------------- Calculate temperature of subframe --------
  IRsensor_fReflectedTemp = MLX90640_GetTa(IRsensor_au16MLX_Frame, &IRsensor_sMLX_Parameters) - TA_SHIFT; //reflected temperature based on the sensor

  /*
  dtostrf((double)tr, 4, 2, str_temp);
  Serial.printf("Ambient temperature: %s�C (%d)\n", str_temp, (int)tr);
   */



  MLX90640_CalculateTo_Custom(IRsensor_au16MLX_Frame, &IRsensor_sMLX_Parameters, IRsensor_fEmissivity, IRsensor_fReflectedTemp, mlx90640To);
  //MLX90640_GetImage(mlx90640Frame, &mlx90640, mlx90640To);
  #endif

   #ifdef TEMPERATURE2CONSOLE
  printTemperaturesToConsole(mlx90640To, 768, 32);
  #endif 
}

void IRsensor_vLoadSubPage_u16(void)
{
    int error;
    uint16_t u16Value;
    uint16_t u16StatusRegister;

    /* Read data from measured subpage */
	(void)MLX90640_GetFrameData_Custom(MLX90640_ADR, IRsensor_au16MLX_Frame, IRsensor_u8subPage);

	/* Clear data ready flag (bit 4) in status register  */
	error = MLX90640_I2CRead(MLX90640_ADR, MLX90640_STATUS_REG_ADDR, 1, &u16StatusRegister);
	if(error == 0)
	{
		u16Value = (u16StatusRegister & 0xFFF7);
		error = MLX90640_I2CWrite(MLX90640_ADR, 0x8000, u16Value);
	}

#ifdef LIVE_DATA

#else
	for(uint16_t i = 0; i < 768; i++)
	{
	pu16PixelValue[i] = (uint16_t)((mlx90640To[i] + (float)TEMP_OFFSET_D) * (float)TEMP_SCALE_FACTOR_D);
	//Serial.printf("%d %d|", pu16PixelValue[i], i);
	//if((i%32)==31) Serial.printf("\n");
	}
#endif

#ifdef TEMPERATURE2CONSOLE
	printTemperaturesToConsole(mlx90640To, 768, 32);
#endif
}

void IRsensor_vCalculatePixelTemp_u16(uint16_t* pu16PixelValue)
{
	/* Calculate reflected (ambient) temperature */
	IRsensor_fReflectedTemp = MLX90640_GetTa(IRsensor_au16MLX_Frame, &IRsensor_sMLX_Parameters) - TA_SHIFT;
	ets_printf("RT = %d \n",(int32_t)IRsensor_fReflectedTemp);

	MLX90640_CalculateTo_Custom_u16(IRsensor_au16MLX_Frame, &IRsensor_sMLX_Parameters, IRsensor_fEmissivity, IRsensor_fReflectedTemp, pu16PixelValue);
}

void IRsensor_UpdateMinMax(float* min_t, float* max_t, float* pixelValue)
{
	*min_t = (300+50)*128;
    *max_t = (-40+50)*128;
    for(uint16_t i=0;i<768;i++)
    {
      if(pixelValue[i] > *max_t) *max_t = pixelValue[i];
      if(pixelValue[i] < *min_t) *min_t = pixelValue[i];    
    }
}

void IRsensor_UpdateMinMax_u16(uint16_t* pu16MinTemp, uint16_t* pu16MaxTemp, uint16_t* pu16PixelValue)
{
    *pu16MinTemp = (uint16_t)((300 + TEMP_OFFSET_D) * TEMP_SCALE_FACTOR_D);
    *pu16MaxTemp = (uint16_t)((-40 + TEMP_OFFSET_D) * TEMP_SCALE_FACTOR_D);

    for(uint16_t i = 0; i < 768u; i++)
    {
        if(pu16PixelValue[i] > *pu16MaxTemp)
        {
          *pu16MaxTemp = pu16PixelValue[i];
        } 
        if(pu16PixelValue[i] < *pu16MinTemp) 
        {
          *pu16MinTemp = pu16PixelValue[i];    
        }
    }
}

uint8_t IRsensor_u8CurrentSubPage(void)
{
	return(IRsensor_u8subPage);
}
