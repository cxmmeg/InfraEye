#include <Adafruit_GFX.h>
#include <Adafruit_ILI9341.h>
#include "module_LCD.h"
#include "config.h"

const uint16_t colorPalete[] = {0x1,0x2,0x3,0x4,0x5,0x5,0x6,0x6,0x7,0x7,0x8,0x8,0x9,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0xfffe,0xfffe};

Adafruit_ILI9341 tft = Adafruit_ILI9341(TFT_CS, TFT_DC);

void LCD_Init(void)
{
	tft.begin();
	tft.fillRect(0, 0, 240, 320, 0x00031);

}

void LCD_PrintStats(uint16_t x, uint16_t y, float max_t, float min_t, float FPS)
{
  static uint8_t first = 1;
  char str_temp[6];
  float constDegToScale;
  uint16_t colorIndex;

  if(first)
  {
    first = 0;
    tft.fillRect(x, y, 240, 120, 0x0000);
    tft.setTextColor(ILI9341_WHITE);
    tft.setTextSize(2);
    for(uint16_t i=0;i<240;i++)
    {
      constDegToScale = ((float)240 - (float)0) / ((float)403 - (float)1);
      colorIndex = (uint16_t)(((float)i) / constDegToScale);
      tft.fillRect(x+i, y, 1, 10, colorPalete[colorIndex]);
    }
  }  
  tft.setCursor(x, y+10);  
  dtostrf((double)min_t, 3, 0, str_temp);
  tft.fillRect(x, y+10, 50, 15, 0x0000);
  tft.printf("%sC", str_temp);
  tft.setCursor(x+180, y+10);
  dtostrf((double)max_t, 3, 0, str_temp);
  tft.fillRect(x+180, y+10, 50, 15, 0x0000);
  tft.printf("%sC", str_temp);
  dtostrf((double)FPS, 2, 1, str_temp);  
  tft.setCursor(x+0, y+100);
  tft.fillRect(x+0, y+100, 60, 15, 0x0000);
  tft.printf("%sFPS", str_temp);  
}

void LCD_drawImage(uint16_t *colorArray, uint16_t columns, uint16_t rows, uint16_t x0, uint16_t y0, uint8_t pixelSize, uint8_t debug)
{
  char str_temp[6];
  uint16_t x, y;
  //tft.fillRect(0, 0, 8, 8, 0xFFFF);
  for(uint16_t i=0;i<columns*rows;i++)
  {
    x = (columns-(i%columns));    
    y = (i/columns);
    
  //if((((subPage+i+(y%2))%2)==1))

      if(debug==1)
      {
        if((i%columns)==0)
        {
          Serial.printf("\n");
          wdt_reset();
        }
        //dtostrf(colorArray[i], 2, 0, str_temp);  
        //Serial.printf("%s;", str_temp);
        Serial.printf("%.2x;", colorArray[i]);
      }
      Serial.printf("|x%dy%dc%x| ", x, y, colorArray[i]);      
      if(pixelSize==1)
      {
        tft.drawPixel(x+x0, y+y0, colorArray[i]);
      }else
      {
        tft.fillRect(x*pixelSize+x0, y*pixelSize+y0, pixelSize, pixelSize, colorArray[i]);
      }
        
  }
}
  
void LCD_Convert(float *frameTemperature, uint16_t *frameColor, uint16_t frameSize,
  float minTemperature, float maxTemperature, uint8_t subPage)
{
  uint16_t i;
  //uint16_t constDegToScale;
  float constDegToScale;
  uint16_t colorIndex;
  uint16_t colorScaleSize = 403;

//  if(minTemperature>15) minTemperature = 15;
//  if(maxTemperature<50) maxTemperature = 50;
  
  constDegToScale = ((float)maxTemperature - (float)minTemperature) / ((float)colorScaleSize - (float)1);
//  Serial.printf("constDegToScale=%d maxTemperature=%d minTemperature=%d colorScaleSize=%d\n", (int)constDegToScale, maxTemperature, minTemperature, colorScaleSize);

  for(i = 0; i < frameSize; i++)
  {
    //if(((i/OUTPUT_ARRAY_LENGTH_D) % 2) == subPage)
    {
      if(frameTemperature[i] < minTemperature)
      {
        colorIndex = 0;
      }else if(frameTemperature[i] > maxTemperature)
      {
        colorIndex = colorScaleSize - 1;
      }else
      {
        colorIndex = (uint16_t)((frameTemperature[i] - (float)minTemperature) / constDegToScale);
      }      
      //Serial.printf("%.4x", (int)frameTemperature[i]);
      //if((i%32)==0)
      //{
      //  Serial.printf("\n");
      //  wdt_reset();
      //}
      frameColor[i] = colorPalete[colorIndex];
    }
  }
}

void LCD_Convert_u16(uint16_t *frameTemperature, uint16_t *frameColor, uint16_t frameSize,
  float minTemperature, float maxTemperature, uint8_t subPage)
{
  uint16_t i;
  //uint16_t constDegToScale;
  float constDegToScale;
  uint16_t colorIndex;
  uint16_t colorScaleSize = 403;

//  if(minTemperature>15) minTemperature = 15;
//  if(maxTemperature<50) maxTemperature = 50;
  
  constDegToScale = (maxTemperature - minTemperature) / ((float)colorScaleSize - (float)1);
//  Serial.printf("constDegToScale=%d maxTemperature=%d minTemperature=%d colorScaleSize=%d\n", (int)constDegToScale, maxTemperature, minTemperature, colorScaleSize);

  for(i = 0; i < frameSize; i++)
  {
    //if(((i/OUTPUT_ARRAY_LENGTH_D) % 2) == subPage)
    {
      if(frameTemperature[i] < minTemperature)
      {
        colorIndex = 0;
      }else if(frameTemperature[i] > maxTemperature)
      {
        colorIndex = colorScaleSize - 1;
      }else
      {
        colorIndex = (uint16_t)(((float)frameTemperature[i] - (float)minTemperature) / constDegToScale);
      }      
      //Serial.printf("%.4x", (int)frameTemperature[i]);
      //if((i%32)==0)
      //{
      //  Serial.printf("\n");
      //  wdt_reset();
      //}
      frameColor[i] = colorPalete[colorIndex];
    }
  }
}

void LCD_FillRect(uint16_t x, uint16_t y, uint16_t width, uint16_t height, uint16_t color)
{
	tft.fillRect(x, y, width, height, color);
}

